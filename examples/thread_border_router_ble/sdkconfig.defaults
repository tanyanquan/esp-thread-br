## examples/thread_border_router_ble/sdkconfig.defaults
```kconfig
# Thread Border Router + BLE Peripheral Example - Default Configuration
# Target: ESP32-P4 with external RCP supporting ot-rcp + esp-hosted

#
# Serial flasher config
#
CONFIG_ESPTOOLPY_FLASHSIZE_8MB=y
# end of Serial flasher config

#
# Partition Table
#
CONFIG_PARTITION_TABLE_CUSTOM=y
CONFIG_PARTITION_TABLE_CUSTOM_FILENAME="partitions.csv"
CONFIG_PARTITION_TABLE_FILENAME="partitions.csv"
CONFIG_PARTITION_TABLE_OFFSET=0x8000
CONFIG_PARTITION_TABLE_MD5=y
# end of Partition Table

#
# Compiler options
#
CONFIG_COMPILER_OPTIMIZATION_SIZE=y

#
# Newlib
#
CONFIG_NEWLIB_NANO_FORMAT=y

#
# mbedTLS
#
CONFIG_MBEDTLS_CMAC_C=y
CONFIG_MBEDTLS_SSL_PROTO_DTLS=y
CONFIG_MBEDTLS_KEY_EXCHANGE_ECJPAKE=y
CONFIG_MBEDTLS_ECJPAKE_C=y
# end of mbedTLS

#
# OpenThread
#
CONFIG_OPENTHREAD_ENABLED=y
CONFIG_OPENTHREAD_BORDER_ROUTER=y
CONFIG_OPENTHREAD_CLI=y
CONFIG_OPENTHREAD_CLI_ESP_EXTENSION=y
CONFIG_OPENTHREAD_CLI_OTA=y
CONFIG_OPENTHREAD_RCP_COMMAND=y
CONFIG_OPENTHREAD_RADIO_SPINEL_UART=y
CONFIG_OPENTHREAD_TASK_SIZE=8192
# end of OpenThread

#
# OpenThread Border Router Example
#
CONFIG_AUTO_UPDATE_RCP=n
# end of OpenThread Border Router Example

#
# lwIP
#
CONFIG_LWIP_IPV6_FORWARD=y
CONFIG_LWIP_IPV6_NUM_ADDRESSES=12
CONFIG_LWIP_MULTICAST_PING=y
CONFIG_LWIP_NETIF_STATUS_CALLBACK=y
CONFIG_LWIP_HOOK_IP6_ROUTE_DEFAULT=y
CONFIG_LWIP_HOOK_ND6_GET_GW_DEFAULT=y
CONFIG_LWIP_HOOK_IP6_INPUT_CUSTOM=y
CONFIG_LWIP_IPV6_AUTOCONFIG=y
CONFIG_LWIP_HOOK_IP6_SELECT_SRC_ADDR_CUSTOM=y
CONFIG_LWIP_FORCE_ROUTER_FORWARDING=y
CONFIG_LWIP_TCP_SND_BUF_DEFAULT=65534
CONFIG_LWIP_TCP_WND_DEFAULT=65534
CONFIG_LWIP_TCP_RECVMBOX_SIZE=64
CONFIG_LWIP_UDP_RECVMBOX_SIZE=64
CONFIG_LWIP_TCPIP_RECVMBOX_SIZE=64
CONFIG_LWIP_TCP_SACK_OUT=y
# end of lwIP

#
# mDNS
#
CONFIG_MDNS_MULTIPLE_INSTANCE=y
CONFIG_MDNS_MAX_SERVICES=200
# end of mDNS

#
# ESP System Settings
#
CONFIG_ESP_SYSTEM_EVENT_TASK_STACK_SIZE=4096
CONFIG_ESP_MAIN_TASK_STACK_SIZE=6144
# end of ESP System Settings

#
# http server
#
CONFIG_HTTPD_MAX_REQ_HDR_LEN=1024

#
# BLE Configuration
#
CONFIG_BT_ENABLED=y
# Host manages the controller (on RCP via esp-hosted)
CONFIG_BT_CONTROLLER_DISABLED=y
# Use NimBLE stack
CONFIG_BT_BLUEDROID_ENABLED=n
CONFIG_BT_NIMBLE_ENABLED=y
# Disable UART HCI - we use VHCI via esp-hosted
CONFIG_BT_NIMBLE_TRANSPORT_UART=n

#
# ESP-Hosted BLE Configuration
# Enables NimBLE host with VHCI transport to RCP
#
CONFIG_ESP_HOSTED_ENABLE_BT_NIMBLE=y
CONFIG_ESP_HOSTED_NIMBLE_HCI_VHCI=y

#
# Wi-Fi Remote Configuration (uses ESP-Hosted)
#
CONFIG_ESP_WIFI_REMOTE_LIBRARY_HOSTED=y

#
# Wi-Fi Remote performance config
#
CONFIG_ESP_WIFI_STATIC_RX_BUFFER_NUM=16
CONFIG_ESP_WIFI_DYNAMIC_RX_BUFFER_NUM=64
CONFIG_ESP_WIFI_DYNAMIC_TX_BUFFER_NUM=64
CONFIG_ESP_WIFI_AMPDU_TX_ENABLED=y
CONFIG_ESP_WIFI_TX_BA_WIN=32
CONFIG_ESP_WIFI_AMPDU_RX_ENABLED=y
CONFIG_ESP_WIFI_RX_BA_WIN=32

#
# FreeRTOS tick rate (recommended for BLE timing)
#
CONFIG_FREERTOS_HZ=1000
```

## examples/thread_border_router_ble/sdkconfig.defaults.esp32p4
```kconfig
# ESP32-P4 specific configuration for Thread BR + BLE Example

#
# Board Configuration
#
CONFIG_ESP_BR_BOARD_P4=y

#
# Console Configuration
#
CONFIG_ESP_CONSOLE_USB_SERIAL_JTAG=y

#
# Thread BR Auto Start
#
CONFIG_OPENTHREAD_BR_AUTO_START=y

#
# PPP Support (for ESP-Hosted communication)
#
CONFIG_LWIP_PPP_SUPPORT=y
CONFIG_LWIP_PPP_SERVER_SUPPORT=y

#
# Backbone Network Interface
#
CONFIG_EXAMPLE_USE_INTERNAL_ETHERNET=y

#
# RCP Target
#
CONFIG_ESP_BR_C6_TARGET=y

#
# UART pins to RCP (adjust if your hardware differs)
#
CONFIG_PIN_TO_RCP_TX=4
CONFIG_PIN_TO_RCP_RX=5
```
